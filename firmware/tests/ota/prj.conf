## CMakeLists.txt
```
# CMakeLists.txt — OTA update ztest suite (native_sim).
#
# Drives the full start/data/finish/abort frame protocol and the rejection
# paths against the native_sim flash simulator; no broker is required.

cmake_minimum_required(VERSION 3.20.0)

find_package(Zephyr REQUIRED HINTS $ENV{ZEPHYR_BASE})
project(test_ota)

target_sources(app PRIVATE
  src/main.c
  ../../src/ota/ota_update.c
  ../../src/fault_inject.c
)
target_include_directories(app PRIVATE ../../src/ota ../../src)
```

## Kconfig
```
# Kconfig — OTA ztest suite.
# Sources the shared application symbols so the suite shares one definition.

mainmenu "OTA ztest"

source "Kconfig.zephyr"
source "$(APPLICATION_SOURCE_DIR)/../../Kconfig.appdefs"
```

## prj.conf
```kconfig
# prj.conf — OTA ztest suite (native_sim)
CONFIG_ZTEST=y
CONFIG_LOG=y

# Flash simulator + MCUboot image management for OTA testing.
# Note: CONFIG_BOOTLOADER_MCUBOOT is NOT enabled on native_sim because it
# requires HAS_FLASH_LOAD_OFFSET which native_sim does not provide.
CONFIG_FLASH=y
CONFIG_FLASH_MAP=y
CONFIG_FLASH_SIMULATOR=y
CONFIG_FLASH_PAGE_LAYOUT=y
CONFIG_IMG_MANAGER=y
CONFIG_IMG_BLOCK_BUF_SIZE=512
# Erase slot1 pages as chunks arrive (required for NOR flash and the simulator).
CONFIG_IMG_ERASE_PROGRESSIVELY=y
CONFIG_STREAM_FLASH=y

# Networking (required by ota_update.c for MQTT types).
CONFIG_NETWORKING=y
CONFIG_NET_NATIVE=y
CONFIG_NET_SOCKETS=y
CONFIG_NET_TCP=y
CONFIG_NET_IPV4=y
CONFIG_MQTT_LIB=y

# Larger stack for flash operations.
CONFIG_MAIN_STACK_SIZE=8192
```

## boards/native_sim.overlay
```dts
/*
 * native_sim.overlay — Flash simulator with MCUboot partitions for OTA testing.
 *
 * Defines a simulated flash device with the partition layout expected by
 * MCUboot: slot0 (current image), slot1 (OTA staging area), and scratch.
 * The OTA module writes to slot1_partition and marks it for swap.
 */

/ {
	sim_flash: sim-flash@0 {
		compatible = "zephyr,sim-flash";
		reg = <0x0 0x100000>;  /* 1MB simulated flash */
		status = "okay";

		partitions {
			compatible = "fixed-partitions";
			#address-cells = <1>;
			#size-cells = <1>;

			/* MCUboot bootloader area (64KB). */
			partition0: partition@0 {
				label = "mcuboot";
				reg = <0x0 0x10000>;
			};

			/* Slot 0: current running image (448KB). */
			partition1: partition@10000 {
				label = "image-0";
				reg = <0x10000 0x70000>;
			};

			/* Slot 1: OTA staging area (448KB). */
			slot1_partition: partition@80000 {
				label = "image-1";
				reg = <0x80000 0x70000>;
			};

			/* Scratch area (64KB). */
			partition3: partition@f0000 {
				label = "image-scratch";
				reg = <0xf0000 0x10000>;
			};
		};
	};
};

/* Alias the flash simulator for the flash_map API. */
/aliases {
	sim-flash = &sim_flash;
};
```

## src/main.c
```c
/*
 * main.c — ztest suite for the OTA update module (ota_update.c).
 *
 * Drives the full frame protocol (start/data/finish/abort) against the
 * native_sim flash simulator and verifies every rejection path: malformed
 * control frames, zero/oversized images, data before start, chunk overflow,
 * and finish-size mismatch. This is the session-level coverage that the old
 * state-getter-only suite claimed but did not provide.
 */

#include <string.h>

#include <zephyr/kernel.h>
#include <zephyr/net/mqtt.h>
#include <zephyr/ztest.h>

#include "ota_update.h"

#define TEST_TOPIC "cmd/native-sim-001/ota"

static void ota_before(void *fixture)
{
	ARG_UNUSED(fixture);
	ota_reset();
	zassert_ok(ota_init(), "ota_init failed");
}

ZTEST_SUITE(ota_tests, NULL, NULL, ota_before, NULL, NULL);

static void make_start(uint8_t frame[OTA_START_FRAME_LEN], uint32_t size)
{
	frame[0] = OTA_FRAME_START;
	frame[1] = (uint8_t)(size >> 24);
	frame[2] = (uint8_t)(size >> 16);
	frame[3] = (uint8_t)(size >> 8);
	frame[4] = (uint8_t)size;
}

ZTEST(ota_tests, test_init_succeeds)
{
	zassert_equal(ota_get_state(), OTA_STATE_IDLE, "state not IDLE after init");
	zassert_equal(ota_bytes_received(), 0, "bytes_received not 0 after init");
	zassert_false(ota_is_subscribed(), "must not be subscribed before CONNACK");
}

ZTEST(ota_tests, test_topic_match)
{
	struct mqtt_topic match = {
		.topic = {
			.utf8 = (uint8_t *)TEST_TOPIC,
			.size = strlen(TEST_TOPIC),
		},
		.qos = MQTT_QOS_1_AT_LEAST_ONCE,
	};
	struct mqtt_topic other = {
		.topic = {
			.utf8 = (uint8_t *)"cmd/other/ota",
			.size = strlen("cmd/other/ota"),
		},
		.qos = MQTT_QOS_1_AT_LEAST_ONCE,
	};

	zassert_true(ota_matches_topic(&match), "topic should match");
	zassert_false(ota_matches_topic(&other), "topic should not match");
	zassert_false(ota_matches_topic(NULL), "NULL topic should not match");
}

ZTEST(ota_tests, test_full_session)
{
	uint8_t start[OTA_START_FRAME_LEN];
	uint8_t data_a[] = {OTA_FRAME_DATA, 'A', 'B'};
	uint8_t data_b[] = {OTA_FRAME_DATA, 'C', 'D'};
	uint8_t finish[] = {OTA_FRAME_FINISH};

	make_start(start, 4);

	zassert_true(ota_handle_frame(start, sizeof(start)));
	zassert_equal(ota_get_state(), OTA_STATE_RECEIVING);

	zassert_true(ota_handle_frame(data_a, sizeof(data_a)));
	zassert_equal(ota_bytes_received(), 2);
	zassert_true(ota_handle_frame(data_b, sizeof(data_b)));
	zassert_equal(ota_bytes_received(), 4);

	zassert_true(ota_handle_frame(finish, sizeof(finish)));
	zassert_equal(ota_get_state(), OTA_STATE_COMPLETE);
	zassert_equal(ota_bytes_received(), 4);
}

ZTEST(ota_tests, test_reject_zero_size)
{
	uint8_t start[OTA_START_FRAME_LEN];

	make_start(start, 0);
	zassert_true(ota_handle_frame(start, sizeof(start)));
	zassert_equal(ota_get_state(), OTA_STATE_ERROR);
}

ZTEST(ota_tests, test_reject_oversized_image)
{
	uint8_t start[OTA_START_FRAME_LEN];

	make_start(start, CONFIG_OTA_MAX_IMAGE_SIZE + 1u);
	zassert_true(ota_handle_frame(start, sizeof(start)));
	zassert_equal(ota_get_state(), OTA_STATE_ERROR);
}

ZTEST(ota_tests, test_reject_malformed_start)
{
	uint8_t short_start[OTA_START_FRAME_LEN - 1] = {OTA_FRAME_START, 0, 0, 1};

	zassert_true(ota_handle_frame(short_start, sizeof(short_start)));
	zassert_equal(ota_get_state(), OTA_STATE_ERROR);
}

ZTEST(ota_tests, test_data_before_start_ignored)
{
	uint8_t data[] = {OTA_FRAME_DATA, 'X'};

	zassert_true(ota_handle_frame(data, sizeof(data)));
	zassert_equal(ota_get_state(), OTA_STATE_IDLE);
	zassert_equal(ota_bytes_received(), 0);
}

ZTEST(ota_tests, test_reject_chunk_overflow)
{
	uint8_t start[OTA_START_FRAME_LEN];
	uint8_t data[] = {OTA_FRAME_DATA, 'A', 'B', 'C'};

	make_start(start, 2);
	zassert_true(ota_handle_frame(start, sizeof(start)));
	zassert_true(ota_handle_frame(data, sizeof(data)));
	zassert_equal(ota_get_state(), OTA_STATE_ERROR);
}

ZTEST(ota_tests, test_reject_finish_size_mismatch)
{
	uint8_t start[OTA_START_FRAME_LEN];
	uint8_t data[] = {OTA_FRAME_DATA, 'A', 'B'};
	uint8_t finish[] = {OTA_FRAME_FINISH};

	make_start(start, 4);
	zassert_true(ota_handle_frame(start, sizeof(start)));
	zassert_true(ota_handle_frame(data, sizeof(data)));
	zassert_true(ota_handle_frame(finish, sizeof(finish)));
	zassert_equal(ota_get_state(), OTA_STATE_ERROR);
}

ZTEST(ota_tests, test_abort_resets)
{
	uint8_t start[OTA_START_FRAME_LEN];
	uint8_t abort[] = {OTA_FRAME_ABORT};

	make_start(start, 8);
	zassert_true(ota_handle_frame(start, sizeof(start)));
	zassert_equal(ota_get_state(), OTA_STATE_RECEIVING);

	zassert_true(ota_handle_frame(abort, sizeof(abort)));
	zassert_equal(ota_get_state(), OTA_STATE_IDLE);
	zassert_equal(ota_bytes_received(), 0);
}

ZTEST(ota_tests, test_unknown_opcode_is_consumed)
{
	uint8_t frame[] = {0x7F, 0x00};

	zassert_true(ota_handle_frame(frame, sizeof(frame)));
	zassert_equal(ota_get_state(), OTA_STATE_IDLE);
}

ZTEST(ota_tests, test_mark_for_swap)
{
	zassert_ok(ota_mark_for_swap());
}
```
